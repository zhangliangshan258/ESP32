## sdkconfig.defaults
```kconfig
CONFIG_PARTITION_TABLE_CUSTOM=y
CONFIG_COMPILER_OPTIMIZATION_PERF=y

# FreeRTOS configuration
CONFIG_FREERTOS_HZ=1000

# LVGL configuration
CONFIG_LV_USE_CLIB_MALLOC=y
CONFIG_LV_USE_CLIB_STRING=y
CONFIG_LV_USE_CLIB_SPRINTF=y
CONFIG_LV_DEF_REFR_PERIOD=15
CONFIG_LV_DPI_DEF=60
CONFIG_LV_OS_FREERTOS=y
CONFIG_LV_DRAW_LAYER_SIMPLE_BUF_SIZE=48000
CONFIG_LV_DRAW_THREAD_PRIO=4
CONFIG_LV_DRAW_SW_SHADOW_CACHE_SIZE=4
CONFIG_LV_GRADIENT_MAX_STOPS=4
CONFIG_LV_OBJ_STYLE_CACHE=y
CONFIG_LV_USE_SYSMON=y

# 仪表盘用到的字号（LVGL 只编译这里选中的字体，能省 flash）
CONFIG_LV_FONT_MONTSERRAT_20=y
CONFIG_LV_FONT_MONTSERRAT_24=y
CONFIG_LV_FONT_MONTSERRAT_26=y
# 中文字形（WiFi 名称 / 中文标签用），16px 常用汉字
CONFIG_LV_FONT_SOURCE_HAN_SANS_SC_16_CJK=y
# 天气卡的大温度用 36px
CONFIG_LV_FONT_MONTSERRAT_36=y
# HTTPS 握手的大缓冲放 PSRAM，避免挤占 LVGL 的 SPI DMA 缓冲
CONFIG_MBEDTLS_EXTERNAL_MEM_ALLOC=y

# CONFIG_ESP_LVGL_ADAPTER_ENABLE_FPS_STATS=y
```
